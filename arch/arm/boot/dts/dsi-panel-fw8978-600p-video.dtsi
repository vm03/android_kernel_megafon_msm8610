/* Copyright (c) 2013, The Linux Foundation. All rights reserved.
 *
 * This program is free software; you can redistribute it and/or modify
 * it under the terms of the GNU General Public License version 2 and
 * only version 2 as published by the Free Software Foundation.
 *
 * This program is distributed in the hope that it will be useful,
 * but WITHOUT ANY WARRANTY; without even the implied warranty of
 * MERCHANTABILITY or FITNESS FOR A PARTICULAR PURPOSE.  See the
 * GNU General Public License for more details.
 */

/*---------------------------------------------------------------------------
 * This file is autogenerated file using gcdb parser. Please do not edit it.
 * Update input XML file to add a new entry or update variable in this file
 * VERSION = "1.0"
 *---------------------------------------------------------------------------*/
&mdss_mdp {
        dsi_fw8978_600p_vid:    qcom,mdss_dsi_fw8978_600p_video_6201 {
                                qcom,mdss-dsi-panel-name = "fw8978 600p video mode dsi panel 6201";
                                qcom,mdss-dsi-panel-controller = <0x1c>;
                                qcom,mdss-dsi-panel-type = "dsi_video_mode";
                                qcom,mdss-dsi-panel-destination = "display_1";
                                qcom,mdss-dsi-panel-frame-rate = <0x3c>;
                                qcom,mdss-dsi-virtual-channel-id = <0x0>;
                                qcom,mdss-dsi-stream = <0x0>;
                                qcom,mdss-dsi-panel-width = <0x400>;
                                qcom,mdss-dsi-panel-height = <0x258>;
                                qcom,mdss-dsi-h-front-porch = <0xa0>;
                                qcom,mdss-dsi-h-back-porch = <0x96>;
                                qcom,mdss-dsi-h-pulse-width = <0x14>;
                                qcom,mdss-dsi-h-sync-skew = <0x0>;
                                qcom,mdss-dsi-v-back-porch = <0x32>;
                                qcom,mdss-dsi-v-front-porch = <0x32>;
                                qcom,mdss-dsi-v-pulse-width = <0x5>;
                                qcom,mdss-dsi-h-left-border = <0x0>;
                                qcom,mdss-dsi-h-right-border = <0x0>;
                                qcom,mdss-dsi-v-top-border = <0x0>;
                                qcom,mdss-dsi-v-bottom-border = <0x0>;
                                qcom,mdss-dsi-bpp = <0x18>;
                                qcom,mdss-dsi-underflow-color = <0xff>;
                                qcom,mdss-dsi-border-color = <0x0>;
                                qcom,mdss-dsi-on-command = [23 01 00 00 00 00 02 7a c1 23 01 00 00 00 00 02 20 00 23 01 00 00 00 00 02 21 58 23 01 00 00 00 00 02 22 24 23 01 00 00 00 00 02 23 a0 23 01 00 00 00 00 02 24 14 23 01 00 00 00 00 02 25 96 23 01 00 00 00 00 02 26 00 23 01 00 00 00 00 02 27 32 23 01 00 00 00 00 02 28 05 23 01 00 00 00 00 02 29 32 23 01 00 00 00 00 02 34 80 23 01 00 00 00 00 02 36 a0 23 01 00 00 00 00 02 b5 a0 23 01 00 00 00 00 02 5c ff 23 01 00 00 00 00 02 13 10 23 01 00 00 00 00 02 56 92 23 01 00 00 00 00 02 6b 32 23 01 00 00 00 00 02 69 4b 23 01 00 00 00 00 02 b6 20 23 01 00 00 00 00 02 51 20 23 01 00 00 00 00 02 09 10 23 01 00 00 00 00 02 7a 3e];
                                qcom,mdss-dsi-on-command-state = "dsi_lp_mode";
                                qcom,mdss-dsi-off-command-state = "dsi_hs_mode";
                                qcom,mdss-dsi-h-sync-pulse = <0x1>;
                                qcom,mdss-dsi-traffic-mode = "non_burst_sync_event";
                                qcom,mdss-dsi-lane-map = <0x0>;
                                qcom,mdss-dsi-bllp-eof-power-mode;
                                qcom,mdss-dsi-bllp-power-mode;
                                qcom,mdss-dsi-lane-0-state;
                                qcom,mdss-dsi-lane-1-state;
                                qcom,mdss-dsi-lane-2-state;
                                qcom,mdss-dsi-lane-3-state;
                                qcom,mdss-dsi-panel-timings = <0x8d241900 0x34341d26 0x2a030400>;
                                qcom,mdss-dsi-t-clk-post = <0x1f>;
                                qcom,mdss-dsi-t-clk-pre = <0x2d>;
                                qcom,mdss-dsi-bl-min-level = <0x1e>;
                                qcom,mdss-dsi-bl-max-level = <0xff>;
                                qcom,mdss-dsi-dma-trigger = "trigger_sw";
                                qcom,mdss-dsi-mdp-trigger = "none";
                                qcom,mdss-dsi-bl-pmic-control-type = "bl_ctrl_wled";
                                qcom,mdss-dsi-reset-sequence = <0x1 0x14 0x0 0x2 0x1 0x14>;
                                qcom,mdss-dsi-force_clk_lane_hs = <0x1>;
                                qcom,platform-lcd-stbyb-gpio = <0x1d 0x37 0x0>;
                                qcom,platform-lcd-rst-1p8-gpio = <0x1d 0x46 0x0>;
                                qcom,platform-ic-lvds-1p8-gpio = <0x1d 0x42 0x0>;
                                qcom,mdss-pan-physical-width-dimension = <0x99>;
                                qcom,mdss-pan-physical-height-dimension = <0x5a>;
                                qcom,cont-splash-enabled;
                        };


};
